## dk-a5e013bm16aea-omnimc-sensor/bmc-demo/software/openbmc/Kconfig
```kconfig
mainmenu "Agilex5E OpenBMC Build"

config KAS_INCLUDE_DEFAULT
	string
	default "kas.yml"

menu "FPGA Options"

config KERNEL_BOOTARGS_SD_MMC
    string "Linux kernel bootargs"
    default "console=ttyS0,115200 earlycon root=/dev/mmcblk0p2 rw rootwait panic=-1"
    help
      Command line parameters for Linux Kernel (bootargs) for SD/MMC boot.

config SSBL_BOOT_SOURCE
	string
	default "mmc0"

config FPGA_ENABLE_CORE_PGM_CONFIG
    bool "Enable core RBF FPGA configuration"
    default y
    help
      Enable this option to perform core RBF FPGA programming, applicable only for HPS boot first.

config FPGA_ENABLE_CORE_PGM
    string
    default "1" if FPGA_ENABLE_CORE_PGM_CONFIG
    default "0"

config FPGA_RBF_FILE
    string "Core RBF configuration bitstream filename"
    default "baseline_a55.core.rbf"
    depends on FPGA_ENABLE_CORE_PGM_CONFIG
    help
      Specify the .rbf file for FPGA programming. It's expected that the RBF file is located under meta-custom/recipes-fpga/fpga-bitstream/files/.

endmenu
```

## dk-a5e013bm16aea-omnimc-sensor/bmc-demo/software/openbmc/kas/image/Kconfig
```kconfig
menu "Image target selection"

config OBMC_PHOSPHOR_IMAGE
	bool "OpenBMC Phosphor Image"
	default y
	help
	  Build the OpenBMC phosphor image (obmc-phosphor-image). This is the
	  standard OpenBMC image providing Redfish, IPMI, and the bmcweb UI.

endmenu
```
